## CMakeLists.txt
```
cmake_minimum_required(VERSION 3.20.0)

find_package(Zephyr REQUIRED HINTS $ENV{ZEPHYR_BASE})
project(createflow_dongle)

target_sources(app PRIVATE
  src/main.c
  src/battery.c
  src/usb_hid.c
  src/dfu_trigger.c
)
```

## prj.conf
```kconfig
# createflow dongle: BLE HID bridge.
# Central + HID-over-GATT client towards the keyboard, USB HID device towards the host.

# --- Bluetooth ---
CONFIG_BT=y
CONFIG_BT_CENTRAL=y
CONFIG_BT_SMP=y
CONFIG_BT_GATT_CLIENT=y
CONFIG_BT_GATT_DM=y
CONFIG_BT_HOGP=y
CONFIG_BT_ATT_TX_COUNT=5
CONFIG_HEAP_MEM_POOL_SIZE=2048

# Scan for devices advertising the HID service (0x1812) and connect automatically
CONFIG_BT_SCAN=y
CONFIG_BT_SCAN_FILTER_ENABLE=y
CONFIG_BT_SCAN_UUID_CNT=1

# Persist the bond so the keyboard is found again after a power cycle
CONFIG_BT_SETTINGS=y
CONFIG_FLASH=y
CONFIG_FLASH_PAGE_LAYOUT=y
CONFIG_FLASH_MAP=y
CONFIG_SETTINGS=y
CONFIG_NVS=y

# The dongle initiates pairing
CONFIG_BT_GATT_AUTO_SEC_REQ=y
CONFIG_BT_BONDABLE=y

CONFIG_BT_DEVICE_NAME="createflow Dongle"

# --- USB (usbd stack) ---
CONFIG_USB_DEVICE_STACK_NEXT=y
CONFIG_USBD_HID_SUPPORT=y
CONFIG_USBD_CDC_ACM_CLASS=y
# The board enables CDC_ACM_SERIAL_INITIALIZE_AT_BOOT by default, which brings up its own
# USB device (CDC ACM only) before main() and claims the controller. Zephyr documents that
# option as meant for applications with no other USB features. We register HID and CDC ACM
# ourselves in usb_hid.c.
CONFIG_CDC_ACM_SERIAL_INITIALIZE_AT_BOOT=n

# Needed to read the baud rate set by the host (dfu_trigger.c) and to reboot
CONFIG_UART_LINE_CTRL=y
CONFIG_REBOOT=y

# --- Stacks and logging ---
CONFIG_MAIN_STACK_SIZE=2048
CONFIG_SYSTEM_WORKQUEUE_STACK_SIZE=2048
CONFIG_BT_TX_PROCESSOR_STACK_SIZE=1024
CONFIG_LOG=y
# Log over the USB serial port. RTT would need a debugger, which a bare USB stick lacks.
CONFIG_USE_SEGGER_RTT=n
CONFIG_LOG_BACKEND_RTT=n
CONFIG_LOG_BACKEND_UART=y
CONFIG_LOG_BUFFER_SIZE=4096
```

## app.overlay
```dts
/*
 * USB HID device carrying the keyboard's own report map (see usb_hid.c).
 * Report sizes include the leading report ID byte: input = 1 + 12 (consumer, the
 * largest report), output = 1 + 1 (keyboard LEDs).
 */
/ {
	hid_dev_0: hid_dev_0 {
		compatible = "zephyr,hid-device";
		label = "createflow-kbd";
		protocol-code = "keyboard";
		in-report-size = <13>;
		in-polling-period-us = <1000>;
		out-report-size = <2>;
		out-polling-period-us = <1000>;
	};
};

/* Log port. The default 1 KB TX FIFO overflows on the burst of messages emitted while
 * connecting; anything that does not fit is dropped by the driver. */
&board_cdc_acm_uart {
	tx-fifo-size = <8192>;
};
```

## src/main.c
```c
/*
 * createflow dongle - BLE HID bridge.
 *
 * Scan for devices advertising the HID service (0x1812), connect, bond, discover the
 * HID-over-GATT service, subscribe to every input report and forward each one to USB
 * unchanged, report ID first (usb_hid.c). The dongle offers the keyboard's own report map
 * on USB, so nothing needs translating.
 */
#include "bridge.h"
#include "battery.h"

#include <string.h>

#include <zephyr/kernel.h>
#include <zephyr/settings/settings.h>
#include <zephyr/bluetooth/bluetooth.h>
#include <zephyr/bluetooth/conn.h>
#include <zephyr/bluetooth/gatt.h>
#include <zephyr/bluetooth/uuid.h>
#include <bluetooth/gatt_dm.h>
#include <bluetooth/scan.h>
#include <bluetooth/services/hogp.h>
#include <zephyr/drivers/gpio.h>
#include <zephyr/logging/log.h>
#include <app_version.h>

LOG_MODULE_REGISTER(bridge, LOG_LEVEL_INF);

/* Status LEDs. Until USB is up there is no log port, so these are the only sign of life:
 * led_run = main() reached (green on the Nordic dongle, red on the EBYTE clone),
 * led_error = USB start failed, led_usb = USB enabled. */
static const struct gpio_dt_spec led_run = GPIO_DT_SPEC_GET(DT_ALIAS(led0), gpios);
static const struct gpio_dt_spec led_error = GPIO_DT_SPEC_GET(DT_ALIAS(led1), gpios);
static const struct gpio_dt_spec led_usb = GPIO_DT_SPEC_GET(DT_ALIAS(led3), gpios);

static void led_on(const struct gpio_dt_spec *led)
{
	gpio_pin_configure_dt(led, GPIO_OUTPUT_ACTIVE);
}

static struct bt_hogp hogp;

/* --- Counters, logged every 30 s while something changes --- */

static struct {
	uint32_t received;      /* reports from the keyboard */
	uint32_t sent;          /* handed to USB */
	uint32_t usb_not_ready; /* host has not opened the interface yet */
	uint32_t rejected;      /* USB refused the report */
	uint32_t connections;
	uint32_t disconnects;
} stats;

static void log_stats(struct k_work *work);
static K_WORK_DELAYABLE_DEFINE(stats_work, log_stats);

static void log_stats(struct k_work *work)
{
	ARG_UNUSED(work);
	static uint32_t last_total;
	uint32_t total = stats.received + stats.connections + stats.disconnects;

	if (total != last_total) {
		last_total = total;
		LOG_INF("stats: %u received, %u sent, %u usb-not-ready, %u rejected | "
			"%u connections, %u disconnects",
			stats.received, stats.sent, stats.usb_not_ready, stats.rejected,
			stats.connections, stats.disconnects);
	}
	k_work_schedule(&stats_work, K_SECONDS(30));
}

/* --- Status line for the host ---
 * createflow reads the dongle's USB serial port and looks for this line: whether the keyboard is
 * connected over the air, and its battery charge (-1 while unknown). Printed on every change and
 * every 10 s, so a listener that opens the port late still learns the state within seconds. */
static bool link_up;

static void emit_status(void)
{
	/* The dongle's own address: the keyboard keeps it in the dongle's slot, so createflow can tell
	 * which slot is in use without a cable. bt_addr_le_to_str appends " (random)"; cut to 17. */
	bt_addr_le_t ids[CONFIG_BT_ID_MAX];
	size_t n = ARRAY_SIZE(ids);
	char addr[BT_ADDR_LE_STR_LEN] = "-";

	bt_id_get(ids, &n);
	if (n > 0) {
		bt_addr_le_to_str(&ids[0], addr, sizeof(addr));
		addr[17] = '\0';
	}
	LOG_INF("@CFSTATUS v=1 link=%s batt=%d addr=%s", link_up ? "up" : "down", battery_level(), addr);
}

static void status_tick(struct k_work *work);
static K_WORK_DELAYABLE_DEFINE(status_work, status_tick);

static void status_tick(struct k_work *work)
{
	ARG_UNUSED(work);
	emit_status();
	k_work_schedule(&status_work, K_SECONDS(10));
}

/* --- Input reports --- */

/* HOGP only knows a report's size after the first notification, so the size check
 * happens here (in usb_hid_send) rather than when subscribing. */
static uint8_t on_report(struct bt_hogp *hp, struct bt_hogp_rep_info *rep,
			 uint8_t err, const uint8_t *data)
{
	ARG_UNUSED(hp);

	if (err || data == NULL) {
		return BT_GATT_ITER_CONTINUE;
	}
	stats.received++;

	int ret = usb_hid_send(bt_hogp_rep_id(rep), data, bt_hogp_rep_size(rep));
	if (ret == 0) {
		stats.sent++;
	} else if (ret == -EAGAIN) {
		stats.usb_not_ready++;
	} else {
		stats.rejected++;
		if (ret == -EINVAL) {
			LOG_WRN_ONCE("report %u with %u bytes does not match the report map - dropped",
				     bt_hogp_rep_id(rep), (unsigned int)bt_hogp_rep_size(rep));
		} else {
			LOG_WRN("USB rejected report: %d", ret);
		}
	}
	return BT_GATT_ITER_CONTINUE;
}

/* --- Report map check ---
 * The USB side carries a fixed copy of the Naya Create's report map. If the connected
 * keyboard describes something else (different firmware, different device), report sizes
 * no longer line up and the host would receive garbage. So the map is read on every
 * connection and dumped when it differs, ready to be pasted into usb_hid.c. It does not
 * fit in one ATT packet; each chunk schedules the next read until an empty one ends it. */

static uint8_t report_map[512];
static size_t report_map_len;

static void read_report_map(struct k_work *work);
static K_WORK_DEFINE(report_map_work, read_report_map);

static void on_report_map_chunk(struct bt_hogp *hp, uint8_t err, const uint8_t *data,
				size_t size, size_t offset)
{
	ARG_UNUSED(hp);

	if (err) {
		LOG_ERR("report map read: ATT error %u at offset %u", err, (unsigned int)offset);
		return;
	}
	if (data == NULL || size == 0) {
		size_t usb_len;
		const uint8_t *usb_map = usb_hid_report_map(&usb_len);

		if (report_map_len == usb_len && memcmp(report_map, usb_map, usb_len) == 0) {
			LOG_INF("keyboard report map (%u bytes) matches USB", (unsigned int)report_map_len);
			return;
		}
		LOG_WRN("keyboard report map (%u bytes) differs from USB (%u bytes) - "
			"reports will arrive wrong. Copy this map into usb_hid.c:",
			(unsigned int)report_map_len, (unsigned int)usb_len);
		LOG_HEXDUMP_WRN(report_map, report_map_len, "report map");
		return;
	}
	size_t n = MIN(size, sizeof(report_map) - offset);
	memcpy(report_map + offset, data, n);
	report_map_len = offset + n;
	if (n < size) {
		LOG_WRN("report map longer than %u bytes - truncated", (unsigned int)sizeof(report_map));
		return;
	}
	k_work_submit(&report_map_work);
}

static void read_report_map(struct k_work *work)
{
	ARG_UNUSED(work);
	int err = bt_hogp_map_read(&hogp, on_report_map_chunk, report_map_len, K_SECONDS(2));
	if (err) {
		LOG_ERR("report map read failed: %d", err);
	}
}

/* --- HOGP --- */

static void on_pm_update(struct bt_hogp *hp)
{
	LOG_INF("protocol mode now %s", bt_hogp_pm_get(hp) == BT_HIDS_PM_BOOT ? "boot" : "report");
}

/* Only the report protocol is used. ZMK keyboards such as the Naya Create offer no boot
 * keyboard, and every boot-capable keyboard also speaks the report protocol. */
static void hogp_ready(struct bt_hogp *hp)
{
	struct bt_hogp_rep_info *rep = NULL;
	int subscribed = 0;

	while ((rep = bt_hogp_rep_next(hp, rep)) != NULL) {
		uint8_t id = bt_hogp_rep_id(rep);
		bool input = bt_hogp_rep_type(rep) == BT_HIDS_REPORT_TYPE_INPUT;

		LOG_INF("report id=%u %s", id, input ? "input" : "output/feature");
		if (!input) {
			continue;
		}
		int err = bt_hogp_rep_subscribe(hp, rep, on_report);
		if (err) {
			LOG_ERR("subscribe to report %u failed: %d", id, err);
			continue;
		}
		subscribed++;
	}
	if (subscribed == 0) {
		LOG_ERR("no input report subscribed - keyboard unusable");
		return;
	}
	LOG_INF("keyboard connected, forwarding reports");
	link_up = true;
	emit_status();

	report_map_len = 0;
	k_work_submit(&report_map_work);
}

static void hogp_prep_error(struct bt_hogp *hp, int err)
{
	ARG_UNUSED(hp);
	LOG_ERR("HID service discovery failed: %d", err);
}

static const struct bt_hogp_init_params hogp_init = {
	.ready_cb = hogp_ready,
	.prep_error_cb = hogp_prep_error,
	.pm_update_cb = on_pm_update,
};

/* --- GATT discovery --- */

static void dm_completed(struct bt_gatt_dm *dm, void *ctx)
{
	ARG_UNUSED(ctx);
	struct bt_conn *conn = bt_gatt_dm_conn_get(dm);
	int err = bt_hogp_handles_assign(dm, &hogp);
	if (err) {
		LOG_ERR("HOGP handle assignment failed: %d", err);
	}
	bt_gatt_dm_data_release(dm);
	/* HID first, then the battery service: one discovery runs at a time. */
	battery_discover(conn);
}

static void dm_service_not_found(struct bt_conn *conn, void *ctx)
{
	ARG_UNUSED(conn); ARG_UNUSED(ctx);
	LOG_ERR("peer has no HID service");
}

static void dm_error(struct bt_conn *conn, int err, void *ctx)
{
	ARG_UNUSED(conn); ARG_UNUSED(ctx);
	LOG_ERR("service discovery failed: %d", err);
}

static const struct bt_gatt_dm_cb dm_cb = {
	.completed = dm_completed,
	.service_not_found = dm_service_not_found,
	.error_found = dm_error,
};

/* --- Stale bonds --- */

/* A keyboard that no longer has the key for this dongle (its slot was cleared or paired again
 * elsewhere) answers the stored key with "PIN or key missing". The dongle then kept retrying
 * that key and never paired again (seen 2026-09-11). Forget the key instead; the next
 * connection pairs from scratch. Only a bonded peer can answer this way, so a stranger nearby
 * can't make the dongle drop its keyboard. bt_unpair() also ends the connection. */
static bt_addr_le_t stale_peer;

static void forget_stale_peer(struct k_work *work)
{
	ARG_UNUSED(work);
	char addr[BT_ADDR_LE_STR_LEN];

	bt_addr_le_to_str(&stale_peer, addr, sizeof(addr));
	int err = bt_unpair(BT_ID_DEFAULT, &stale_peer);

	if (err) {
		LOG_ERR("forgetting the bond with %s failed: %d", addr, err);
		return;
	}
	LOG_INF("forgot the stale bond with %s, pairing again on the next connection", addr);
}

static K_WORK_DEFINE(forget_work, forget_stale_peer);

/* --- Connection --- */

static void connected(struct bt_conn *conn, uint8_t err)
{
	if (err) {
		LOG_WRN("connection failed: 0x%02x", err);
		bt_scan_start(BT_SCAN_TYPE_SCAN_ACTIVE);
		return;
	}
	stats.connections++;
	LOG_INF("connected, requesting encryption");
	if (bt_conn_set_security(conn, BT_SECURITY_L2)) {
		LOG_WRN("security request failed");
	}
}

static void security_changed(struct bt_conn *conn, bt_security_t level,
			     enum bt_security_err err)
{
	if (err) {
		LOG_WRN("pairing/encryption failed: %d", err);
		if (err == BT_SECURITY_ERR_PIN_OR_KEY_MISSING) {
			bt_addr_le_copy(&stale_peer, bt_conn_get_dst(conn));
			k_work_submit(&forget_work);
		}
		return;
	}
	LOG_INF("encrypted (level %d), discovering HID service", level);
	int e = bt_gatt_dm_start(conn, BT_UUID_HIDS, &dm_cb, NULL);
	if (e) {
		LOG_ERR("service discovery could not start: %d", e);
	}
}

static void disconnected(struct bt_conn *conn, uint8_t reason)
{
	ARG_UNUSED(conn);
	stats.disconnects++;
	link_up = false;
	battery_reset();
	emit_status();
	LOG_INF("disconnected (0x%02x), scanning again", reason);
	if (bt_hogp_assign_check(&hogp)) {
		bt_hogp_release(&hogp);
	}
	bt_scan_start(BT_SCAN_TYPE_SCAN_ACTIVE);
}

BT_CONN_CB_DEFINE(conn_cbs) = {
	.connected = connected,
	.disconnected = disconnected,
	.security_changed = security_changed,
};

/* --- Scanning --- */

static void scan_filter_match(struct bt_scan_device_info *dev,
			      struct bt_scan_filter_match *match, bool connectable)
{
	ARG_UNUSED(match); ARG_UNUSED(connectable);
	char addr[BT_ADDR_LE_STR_LEN];
	bt_addr_le_to_str(dev->recv_info->addr, addr, sizeof(addr));
	LOG_INF("HID device found: %s", addr);
}

static void scan_connecting_error(struct bt_scan_device_info *dev)
{
	ARG_UNUSED(dev);
	LOG_WRN("connecting from scan failed");
}

BT_SCAN_CB_INIT(scan_cb, scan_filter_match, NULL, scan_connecting_error, NULL);

static int scan_setup(void)
{
	struct bt_scan_init_param param = { .connect_if_match = true };
	bt_scan_init(&param);
	bt_scan_cb_register(&scan_cb);

	int err = bt_scan_filter_add(BT_SCAN_FILTER_TYPE_UUID, BT_UUID_HIDS);
	if (err) {
		LOG_ERR("scan filter not set: %d", err);
		return err;
	}
	return bt_scan_filter_enable(BT_SCAN_UUID_FILTER, false);
}

int main(void)
{
	LOG_INF("createflow dongle %s starting", APP_VERSION_STRING);
	led_on(&led_run);

	/* First and independent of everything else: if anything below fails, the 1200 baud
	 * touch is the only way to load new firmware without opening the case. */
	if (dfu_trigger_start()) {
		LOG_ERR("DFU trigger not started");
	}

	int err = usb_hid_start();
	if (err) {
		LOG_ERR("USB HID start failed: %d", err);
		led_on(&led_error);
		return 0;
	}
	led_on(&led_usb);

	bt_hogp_init(&hogp, &hogp_init);

	err = bt_enable(NULL);
	if (err) {
		LOG_ERR("Bluetooth start failed: %d", err);
		return 0;
	}
	settings_load();   /* restore the bond */
	if (scan_setup()) {
		return 0;
	}
	err = bt_scan_start(BT_SCAN_TYPE_SCAN_ACTIVE);
	if (err) {
		LOG_ERR("scan start failed: %d", err);
		return 0;
	}
	LOG_INF("scanning for the keyboard");
	k_work_schedule(&stats_work, K_SECONDS(30));
	battery_on_change(emit_status);
	k_work_schedule(&status_work, K_SECONDS(10));
	return 0;
}
```

## src/battery.c
```c
/*
 * Reads the keyboard's charge over the standard GATT Battery Service (0x180F), characteristic
 * Battery Level (0x2A19): once when the link comes up, then through notifications.
 *
 * One figure only. The Naya Create's whole GATT table, listed from the dongle on 2026-09-14 after
 * encryption, has a single 0x2A19 (value handle 0x0012) and no second one for the other half; the
 * rest is GAP, Device Information, HID and the unused vendor service 0x1234/0x5678. The charge of
 * each half separately is only available over the keyboard's USB protocol.
 */
#include "battery.h"

#include <zephyr/bluetooth/gatt.h>
#include <zephyr/bluetooth/uuid.h>
#include <bluetooth/gatt_dm.h>
#include <zephyr/logging/log.h>

LOG_MODULE_REGISTER(battery, LOG_LEVEL_INF);

static struct bt_gatt_subscribe_params sub;
static struct bt_gatt_read_params read_params;
static int level = -1;
static void (*on_change)(void);

void battery_on_change(void (*cb)(void))
{
	on_change = cb;
}

int battery_level(void)
{
	return level;
}

void battery_reset(void)
{
	level = -1;
	sub.value_handle = 0; /* a fresh subscription is set up on the next connection */
}

static void set_level(uint8_t pct)
{
	if (pct > 100 || pct == level) {
		return;
	}
	level = pct;
	if (on_change) {
		on_change();
	}
}

static uint8_t notify_cb(struct bt_conn *conn, struct bt_gatt_subscribe_params *params,
			 const void *data, uint16_t len)
{
	ARG_UNUSED(conn);
	if (!data) { /* the keyboard cancelled the subscription */
		params->value_handle = 0;
		return BT_GATT_ITER_STOP;
	}
	if (len >= 1) {
		set_level(((const uint8_t *)data)[0]);
	}
	return BT_GATT_ITER_CONTINUE;
}

static uint8_t read_cb(struct bt_conn *conn, uint8_t err, struct bt_gatt_read_params *params,
		       const void *data, uint16_t len)
{
	ARG_UNUSED(conn); ARG_UNUSED(params);
	if (!err && data && len >= 1) {
		set_level(((const uint8_t *)data)[0]);
	}
	return BT_GATT_ITER_STOP;
}

static void dm_completed(struct bt_gatt_dm *dm, void *ctx)
{
	ARG_UNUSED(ctx);
	struct bt_conn *conn = bt_gatt_dm_conn_get(dm);
	const struct bt_gatt_dm_attr *chrc = bt_gatt_dm_char_by_uuid(dm, BT_UUID_BAS_BATTERY_LEVEL);
	const struct bt_gatt_dm_attr *val =
		chrc ? bt_gatt_dm_desc_by_uuid(dm, chrc, BT_UUID_BAS_BATTERY_LEVEL) : NULL;

	if (!val) {
		LOG_WRN("battery service has no battery-level value");
		bt_gatt_dm_data_release(dm);
		return;
	}

	read_params.func = read_cb;
	read_params.handle_count = 1;
	read_params.single.handle = val->handle;
	read_params.single.offset = 0;
	int err = bt_gatt_read(conn, &read_params);

	if (err) {
		LOG_WRN("battery read failed: %d", err);
	}

	const struct bt_gatt_dm_attr *ccc = bt_gatt_dm_desc_by_uuid(dm, chrc, BT_UUID_GATT_CCC);

	if (ccc) {
		sub.notify = notify_cb;
		sub.value = BT_GATT_CCC_NOTIFY;
		sub.value_handle = val->handle;
		sub.ccc_handle = ccc->handle;
		err = bt_gatt_subscribe(conn, &sub);
		if (err && err != -EALREADY) {
			LOG_WRN("battery subscribe failed: %d", err);
		}
	}
	bt_gatt_dm_data_release(dm);
}

static void dm_service_not_found(struct bt_conn *conn, void *ctx)
{
	ARG_UNUSED(conn); ARG_UNUSED(ctx);
	LOG_INF("keyboard has no battery service over BLE");
}

static void dm_error(struct bt_conn *conn, int err, void *ctx)
{
	ARG_UNUSED(conn); ARG_UNUSED(ctx);
	LOG_WRN("battery service discovery failed: %d", err);
}

static const struct bt_gatt_dm_cb dm_cb = {
	.completed = dm_completed,
	.service_not_found = dm_service_not_found,
	.error_found = dm_error,
};

void battery_discover(struct bt_conn *conn)
{
	int err = bt_gatt_dm_start(conn, BT_UUID_BAS, &dm_cb, NULL);

	if (err) {
		LOG_WRN("battery discovery could not start: %d", err);
	}
}
```

## src/battery.h
```c
/*
 * The keyboard's Battery Service over BLE. The keyboard reports its charge over the standard
 * GATT Battery Service (0x180F); the dongle reads it and, through main.c, passes it to the host
 * so createflow can show the charge without a cable.
 */
#pragma once

#include <zephyr/bluetooth/conn.h>

/* Start discovering and reading the battery level on this connection. Call once the link is
 * encrypted and no other discovery is running; a keyboard without the service leaves it unknown. */
void battery_discover(struct bt_conn *conn);

/* Forget the level on disconnect. */
void battery_reset(void);

/* -1 when unknown, otherwise 0..100. */
int battery_level(void);

/* Called whenever the level changes, so the caller can report it. */
void battery_on_change(void (*cb)(void));
```

## src/bridge.h
```c
/* Shared interface between the BLE side (main.c) and the USB side (usb_hid.c). */
#ifndef CREATEFLOW_DONGLE_BRIDGE_H
#define CREATEFLOW_DONGLE_BRIDGE_H

#include <stddef.h>
#include <stdint.h>

/* Reports as described by the Naya Create's HID report map (read from the keyboard over
 * BLE; the same map is offered on USB, see usb_hid.c). */
#define REPORT_ID_KEYBOARD  1   /* in: 8 bytes (modifiers, reserved, 6 keys); out: 1 byte LEDs */
#define REPORT_ID_CONSUMER  2   /* in: 12 bytes, 6 x 16-bit consumer usages (media, dials) */
#define REPORT_ID_MOUSE     3   /* in: 6 bytes: buttons, x, y, wheel, pan, zoom */
#define REPORT_MAX_LEN      12

#define BOOT_KBD_REPORT_LEN 8

/** Register and enable the USB HID device (plus CDC ACM for logging). 0 on success. */
int usb_hid_start(void);

/** Send an input report to the host; the report ID is prepended.
 *  -EAGAIN while the host has not opened the interface yet, -EINVAL if id/len do not
 *  match the report map. */
int usb_hid_send(uint8_t report_id, const uint8_t *data, size_t len);

/** The report map offered on USB, for comparison with the keyboard's. */
const uint8_t *usb_hid_report_map(size_t *len);

/** Watch the USB serial port for the 1200 baud touch and reboot into the bootloader.
 *  Without it, every firmware update needs the reset button under the case. */
int dfu_trigger_start(void);

#endif
```

## src/dfu_trigger.c
```c
/*
 * Software DFU trigger.
 *
 * The EBYTE E104-BT5040U sits in a closed snap-fit case; its buttons are not reachable
 * without prying it open. This trigger makes updates possible without touching the stick:
 * the host opens the dongle's serial port at 1200 baud (the same touch Arduino boards use),
 * the firmware notices the unusual rate and reboots into the bootloader.
 */
#include "bridge.h"

#include <zephyr/kernel.h>
#include <zephyr/device.h>
#include <zephyr/drivers/uart.h>
#include <zephyr/sys/reboot.h>
#include <zephyr/logging/log.h>
#include <hal/nrf_power.h>
#include <hal/nrf_gpio.h>

LOG_MODULE_REGISTER(dfu_trigger, LOG_LEVEL_INF);

/* Nordic's open bootloader enters DFU when it finds this value in GPREGRET
 * (BOOTLOADER_DFU_START in the nRF5 SDK). The register survives any reset but power loss. */
#define BOOTLOADER_DFU_START 0xB1

/* On the nRF52840 dongle (PCA10059 and clones) P0.19 is wired to the RESET line. Driving
 * it low produces a real pin reset, which the bootloader also treats as "enter DFU". */
#define SELF_PINRESET_PIN 19

#define DFU_BAUDRATE 1200
#define POLL_MS      250

static const struct device *const console = DEVICE_DT_GET(DT_CHOSEN(zephyr_console));

static void reboot_into_bootloader(void)
{
	LOG_INF("1200 baud touch - rebooting into the bootloader");

	nrf_power_gpregret_set(NRF_POWER, 0, BOOTLOADER_DFU_START);

	/* Pin reset first; if a clone does not route P0.19, the plain reboot below still
	 * gets there because GPREGRET survives both. */
	nrf_gpio_cfg_output(SELF_PINRESET_PIN);
	nrf_gpio_pin_clear(SELF_PINRESET_PIN);

	k_msleep(50);
	sys_reboot(SYS_REBOOT_COLD);
}

static void poll_baudrate(struct k_work *work);
static K_WORK_DELAYABLE_DEFINE(poll_work, poll_baudrate);

static void poll_baudrate(struct k_work *work)
{
	ARG_UNUSED(work);
	uint32_t baud = 0;

	/* No baud rate while the host has the port closed - that is the normal case. */
	if (uart_line_ctrl_get(console, UART_LINE_CTRL_BAUD_RATE, &baud) == 0 &&
	    baud == DFU_BAUDRATE) {
		reboot_into_bootloader();
		return;
	}
	k_work_schedule(&poll_work, K_MSEC(POLL_MS));
}

int dfu_trigger_start(void)
{
	if (!device_is_ready(console)) {
		LOG_ERR("console UART not ready - dongle only reachable via the reset button");
		return -EIO;
	}
	k_work_schedule(&poll_work, K_MSEC(POLL_MS));
	LOG_INF("DFU trigger armed (open the port at %d baud)", DFU_BAUDRATE);
	return 0;
}
```

## src/usb_hid.c
```c
/*
 * USB side of the bridge: presents the dongle to the host as a HID device with the
 * keyboard's own report map, plus a CDC ACM port for logging. Input reports from the
 * keyboard are forwarded unchanged, report ID first.
 */
#include "bridge.h"

#include <string.h>
#include <zephyr/kernel.h>
#include <zephyr/device.h>
#include <zephyr/usb/usbd.h>
#include <zephyr/usb/class/usbd_hid.h>
#include <zephyr/logging/log.h>

LOG_MODULE_REGISTER(usb_hid, LOG_LEVEL_INF);

/* Report map read from the Naya Create over HID-over-GATT (212 bytes). main.c re-reads it
 * on every connection and warns if the keyboard's map differs from this one.
 *   Report 1: keyboard - 8 bytes in (modifiers, reserved, 6 keys), 1 byte out (LEDs)
 *   Report 2: consumer - 12 bytes in, 6 x 16-bit usages
 *   Report 3: mouse    - 6 bytes in: 5 buttons, x, y, wheel, AC pan, AC zoom
 * Because the host sees the same description as over Bluetooth, nothing is translated. */
static const uint8_t report_map[] = {
	0x05, 0x01, 0x09, 0x06, 0xa1, 0x01, 0x85, 0x01, 0x05, 0x07, 0x19, 0xe0, 0x29, 0xe7, 0x15, 0x00,
	0x25, 0x01, 0x75, 0x01, 0x95, 0x08, 0x81, 0x02, 0x05, 0x07, 0x75, 0x08, 0x95, 0x01, 0x81, 0x03,
	0x05, 0x07, 0x15, 0x00, 0x26, 0xff, 0x00, 0x19, 0x00, 0x29, 0xff, 0x75, 0x08, 0x95, 0x06, 0x81,
	0x00, 0x05, 0x08, 0x19, 0x01, 0x29, 0x05, 0x15, 0x00, 0x25, 0x01, 0x75, 0x01, 0x95, 0x05, 0x91,
	0x02, 0x75, 0x03, 0x95, 0x01, 0x91, 0x03, 0xc0, 0x05, 0x0c, 0x09, 0x01, 0xa1, 0x01, 0x85, 0x02,
	0x05, 0x0c, 0x15, 0x00, 0x26, 0xff, 0x0f, 0x19, 0x00, 0x2a, 0xff, 0x0f, 0x75, 0x10, 0x95, 0x06,
	0x81, 0x00, 0xc0, 0x05, 0x01, 0x09, 0x02, 0xa1, 0x01, 0x85, 0x03, 0x09, 0x01, 0xa1, 0x00, 0x05,
	0x09, 0x19, 0x01, 0x29, 0x05, 0x15, 0x00, 0x25, 0x01, 0x75, 0x01, 0x95, 0x05, 0x81, 0x02, 0x75,
	0x03, 0x95, 0x01, 0x81, 0x03, 0x05, 0x01, 0x09, 0x30, 0x09, 0x31, 0x15, 0x81, 0x25, 0x7f, 0x75,
	0x08, 0x95, 0x02, 0x81, 0x06, 0xa1, 0x02, 0x09, 0x38, 0x15, 0x81, 0x25, 0x7f, 0x35, 0x00, 0x45,
	0x00, 0x75, 0x08, 0x95, 0x01, 0x81, 0x06, 0xc0, 0xa1, 0x02, 0x05, 0x0c, 0x0a, 0x38, 0x02, 0x15,
	0x81, 0x25, 0x7f, 0x35, 0x00, 0x45, 0x00, 0x75, 0x08, 0x95, 0x01, 0x81, 0x06, 0xc0, 0xa1, 0x02,
	0x0a, 0x2f, 0x02, 0x15, 0x81, 0x25, 0x7f, 0x35, 0x00, 0x45, 0x00, 0x75, 0x08, 0x95, 0x01, 0x81,
	0x06, 0xc0, 0xc0, 0xc0,
};

static const uint8_t report_len[REPORT_ID_MOUSE + 1] = {
	[REPORT_ID_KEYBOARD] = BOOT_KBD_REPORT_LEN,
	[REPORT_ID_CONSUMER] = 12,
	[REPORT_ID_MOUSE] = 6,
};

static const struct device *hid_dev;
static atomic_t usb_ready = ATOMIC_INIT(0);
static atomic_t boot_protocol = ATOMIC_INIT(0);

/* Last report per ID (index = ID) so GET_REPORT can answer; also the aligned send buffer
 * hid_device_submit_report() requires. */
static uint8_t last_report[REPORT_ID_MOUSE + 1][1 + REPORT_MAX_LEN] __aligned(4);

static void iface_ready(const struct device *dev, const bool ready)
{
	ARG_UNUSED(dev);
	atomic_set(&usb_ready, ready ? 1 : 0);
	LOG_INF("USB HID interface %s", ready ? "ready" : "not ready");
}

/* The HID class rejects registration with -EINVAL unless get_report is present, plus
 * set_report when an output report is declared and set_protocol for a boot interface. */

static int get_report(const struct device *dev, const uint8_t type, const uint8_t id,
		      const uint16_t len, uint8_t *const buf)
{
	ARG_UNUSED(dev);

	if (type != HID_REPORT_TYPE_INPUT || id < REPORT_ID_KEYBOARD || id > REPORT_ID_MOUSE ||
	    len < report_len[id]) {
		return -ENOTSUP;
	}
	memcpy(buf, &last_report[id][1], report_len[id]);
	return report_len[id];
}

/* Host sets keyboard LEDs (caps/num/scroll). Accepted, not forwarded yet. */
static int set_report(const struct device *dev, const uint8_t type, const uint8_t id,
		      const uint16_t len, const uint8_t *const buf)
{
	ARG_UNUSED(dev); ARG_UNUSED(type); ARG_UNUSED(id); ARG_UNUSED(len); ARG_UNUSED(buf);
	return 0;
}

/* Only BIOS/UEFI request the boot protocol: no report IDs, keyboard report only.
 * Operating systems stay in the report protocol. */
static void set_protocol(const struct device *dev, const uint8_t proto)
{
	ARG_UNUSED(dev);
	atomic_set(&boot_protocol, proto == HID_PROTOCOL_BOOT);
	LOG_INF("host requests %s protocol", proto == HID_PROTOCOL_BOOT ? "boot" : "report");
}

static const struct hid_device_ops hid_ops = {
	.iface_ready = iface_ready,
	.get_report = get_report,
	.set_report = set_report,
	.set_protocol = set_protocol,
};

/* Nordic's test VID with a PID of our own until a proper one is assigned. */
USBD_DEVICE_DEFINE(dongle_usbd, DEVICE_DT_GET(DT_NODELABEL(zephyr_udc0)), 0x1915, 0x520f);

USBD_DESC_LANG_DEFINE(desc_lang);
USBD_DESC_MANUFACTURER_DEFINE(desc_mfr, "createflow");
USBD_DESC_PRODUCT_DEFINE(desc_product, "createflow Dongle");
USBD_DESC_CONFIG_DEFINE(desc_config, "FS Configuration");

/* Bus powered, bMaxPower in 2 mA units: 50 = 100 mA (the dongle draws well under 50 mA).
 * Asking for the USB maximum of 500 mA made macOS leave the device unconfigured. */
USBD_CONFIGURATION_DEFINE(fs_config, 0, 50, &desc_config);

static int usbd_setup(void)
{
	int err;

	if ((err = usbd_add_descriptor(&dongle_usbd, &desc_lang)) ||
	    (err = usbd_add_descriptor(&dongle_usbd, &desc_mfr)) ||
	    (err = usbd_add_descriptor(&dongle_usbd, &desc_product))) {
		LOG_ERR("descriptor rejected: %d", err);
		return err;
	}
	if ((err = usbd_add_configuration(&dongle_usbd, USBD_SPEED_FS, &fs_config))) {
		LOG_ERR("configuration rejected: %d", err);
		return err;
	}
	if ((err = usbd_register_all_classes(&dongle_usbd, USBD_SPEED_FS, 1, NULL))) {
		LOG_ERR("class registration failed: %d", err);
		return err;
	}
	/* CDC ACM describes itself with an interface association descriptor, which requires
	 * the "miscellaneous / common / IAD" device class triple. */
	if ((err = usbd_device_set_code_triple(&dongle_usbd, USBD_SPEED_FS,
					       USB_BCC_MISCELLANEOUS, 0x02, 0x01))) {
		LOG_ERR("device class rejected: %d", err);
		return err;
	}
	return 0;
}

int usb_hid_start(void)
{
	int err;

	hid_dev = DEVICE_DT_GET_ONE(zephyr_hid_device);
	if (!device_is_ready(hid_dev)) {
		LOG_ERR("HID device not ready");
		return -EIO;
	}
	if ((err = hid_device_register(hid_dev, report_map, sizeof(report_map), &hid_ops))) {
		LOG_ERR("HID registration failed: %d", err);
		return err;
	}
	if ((err = usbd_setup()) || (err = usbd_init(&dongle_usbd))) {
		return err;
	}
	if ((err = usbd_enable(&dongle_usbd))) {
		LOG_ERR("USB enable failed: %d", err);
		return err;
	}
	LOG_INF("USB HID device registered (keyboard, consumer, mouse)");
	return 0;
}

int usb_hid_send(uint8_t report_id, const uint8_t *data, size_t len)
{
	if (report_id < REPORT_ID_KEYBOARD || report_id > REPORT_ID_MOUSE ||
	    len != report_len[report_id]) {
		return -EINVAL;
	}
	if (!atomic_get(&usb_ready)) {
		return -EAGAIN;
	}

	uint8_t *buf = last_report[report_id];
	buf[0] = report_id;
	memcpy(&buf[1], data, len);

	if (atomic_get(&boot_protocol)) {
		if (report_id != REPORT_ID_KEYBOARD) {
			return 0;
		}
		return hid_device_submit_report(hid_dev, len, &buf[1]);
	}
	return hid_device_submit_report(hid_dev, 1 + len, buf);
}

const uint8_t *usb_hid_report_map(size_t *len)
{
	*len = sizeof(report_map);
	return report_map;
}
```
